## testcase.yaml
```yaml
tests:
  modbus_slave.renode:
    build_only: false
    platform_allow: nrf52840dk/nrf52840
    harness: robot
    harness_config:
      robot_testsuite: renode/modbus_slave.robot
```
